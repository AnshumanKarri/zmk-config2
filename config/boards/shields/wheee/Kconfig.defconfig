## config/boards/shields/wheee/Kconfig.defconfig
```kconfig
if SHIELD_WHEEE_LEFT

# Name must be less than 16 characters long!
config ZMK_KEYBOARD_NAME
    default "wheeeMiku"

config ZMK_SPLIT_ROLE_CENTRAL
    default y

endif

if SHIELD_WHEEE_LEFT || SHIELD_WHEEE_RIGHT

config ZMK_SPLIT
    default y

endif

CONFIG_USB=y
CONFIG_ZMK_USB=y
CONFIG_USB_DEVICE_MANUFACTURER="Miku approved keyboard"

CONFIG_BT=y
CONFIG_ZMK_BLE=y
```
