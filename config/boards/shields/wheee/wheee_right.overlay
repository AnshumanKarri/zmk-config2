#include "wheee.dtsi" // The shared dtsi file is included in the overlay

&uart0 {
    status = "disabled";
};

&default_transform { // Offset of 3 because the left side has 3 columns
    col-offset = <5>;
};
// Label of the kscan node in the dtsi
&kscan0 {
    col-gpios
        = <&pro_micro 20 GPIO_ACTIVE_HIGH>
        , <&pro_micro 21 GPIO_ACTIVE_HIGH>
        , <&pro_micro 2 GPIO_ACTIVE_HIGH>
        , <&pro_micro 3 GPIO_ACTIVE_HIGH>
        , <&pro_micro 4 GPIO_ACTIVE_HIGH>4 3 2 21 20
        ;
};
&right_encoder {
    status = "okay";
};
